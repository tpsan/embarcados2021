## linux-toradex/drivers/net/flexray/Kconfig
```kconfig
menu "FlexRay Device Drivers"
	depends on FLEXRAY

config FLEXRAY_VFLEXRAY
	tristate "Virtual Local FlexRay Interface (vflexray)"
	depends on FLEXRAY
	---help---
	  Similar to the network loopback devices, vflexray offers a
	  virtual local FlexRay interface.

	  This driver can also be built as a module.  If so, the module
	  will be called vflexray.

config FLEXRAY_DEV
	tristate "Platform FlexRay drivers with Netlink support"
	depends on FLEXRAY
	default y
	---help---
	  Enables the common framework for platform FlexRay drivers with
	  Netlink support. This is the standard library for FlexRay drivers.
	  If unsure, say Y.

config FLEXRAY_FLEXCARD
	tristate "Support for the Flexcard FlexRay function"
	depends on FLEXRAY_DEV
	---help---
	  Driver for Eberspächer FlexCard PMC II, it supports Flexray and
	  CAN busses.
	  This driver can also be built as a module. If so, the module
	  will be called flexcard_fr.

config FLEXRAY_DEBUG_DEVICES
	bool "FlexRay devices debugging messages"
	depends on FLEXRAY
	---help---
	  Say Y here if you want the Flexray device drivers to produce a bunch
	  of debug messages to the system log.  Select this if you are having
	  a problem with FlexRay support and want to see more of what is going
	  on.

endmenu
```

## linux-toradex/net/flexray/Kconfig
```kconfig
#
# FlexRay network layer core configuration
#

menuconfig FLEXRAY
	depends on NET
	tristate "FlexRay bus subsystem support"
	---help---
	  FlexRay is a slow (up to 10Mbit/s) serial communications
	  protocol which was developed by the FlexRay Consortium, a
	  cooperation of leading companies in the automotive industry, from
	  2000 till 2010, which result in ISO 10681.
	  More information on the FlexRay network protocol family PF_FLEXRAY
	  is contained in <Documentation/networking/flexray.txt>.

	  If you want FLEXRAY support you should say Y here and also to the
	  specific driver for your controller(s) below.

config FLEXRAY_RAW
	tristate "Raw FlexRay Protocol"
	depends on FLEXRAY
	default N
	---help---
	  The raw FlexRay protocol option offers access to the FlexRay bus
	  via the BSD socket API. You probably want to use the raw socket in
	  most cases where no higher level protocol is being used.
	  To receive/send raw FLEXRAY messages, use AF_FLEXRAY with protocol
	  FLEXRAY_RAW.

source "drivers/net/flexray/Kconfig"
```

## u-boot-toradex/board/toradex/mx4_c61/Kconfig
```kconfig
if TARGET_MX4_C61

config SYS_CPU
	default "armv7"

config SYS_BOARD
	default "mx4_c61"

config SYS_VENDOR
	default "toradex"

config SYS_SOC
	default "vf610"

config SYS_CONFIG_NAME
	default "mx4_c61"

config TRDX_CFG_BLOCK
	default y

config TRDX_HAVE_NAND
	default y

config TRDX_CFG_BLOCK_OFFSET
	default "2048"

config TRDX_CFG_BLOCK_2ND_ETHADDR
	default y

endif
```

## u-boot-toradex/board/toradex/mx4_mil/Kconfig
```kconfig
if TARGET_MX4_MIL

config SYS_BOARD
	default "mx4_mil"

config SYS_VENDOR
	default "toradex"

config SYS_CONFIG_NAME
	default "mx4_mil"

config TRDX_CFG_BLOCK
	default y

config TRDX_HAVE_NAND
	default y

config TRDX_CFG_BLOCK_OFFSET
	default "3145728"

endif

if TARGET_MX4_MIL_SE

config SYS_BOARD
	default "mx4_mil"

config SYS_VENDOR
	default "toradex"

config SYS_CONFIG_NAME
	default "mx4_mil_se"

config TRDX_CFG_BLOCK
	default y

config TRDX_HAVE_NAND
	default y

config TRDX_CFG_BLOCK_OFFSET
	default "3145728"

endif
```

## u-boot-toradex/board/toradex/mx4_t20/Kconfig
```kconfig
if TARGET_MX4_T20

config SYS_BOARD
	default "mx4_t20"

config SYS_VENDOR
	default "toradex"

config SYS_CONFIG_NAME
	default "mx4_t20"

config TRDX_CFG_BLOCK
	default y

config TRDX_HAVE_NAND
	default y

config TRDX_CFG_BLOCK_OFFSET
	default "3145728"

endif
```

## u-boot-toradex/configs/mx4_mil_defconfig
```kconfig
CONFIG_ARM=y
CONFIG_TEGRA=y
CONFIG_TARGET_MX4_MIL=y
CONFIG_DEFAULT_DEVICE_TREE="tegra20-colibri"
```

## u-boot-toradex/configs/mx4_mil_vboot_defconfig
```kconfig
CONFIG_ARM=y
CONFIG_TEGRA=y
CONFIG_TARGET_MX4_MIL_SE=y
CONFIG_FIT=y
CONFIG_FIT_SIGNATURE=y
CONFIG_CMD_FIT_VERIFY=y
CONFIG_RSA=y
CONFIG_DEFAULT_DEVICE_TREE="tegra20-colibri"
```

## u-boot-toradex/configs/mx4_t20_defconfig
```kconfig
CONFIG_ARM=y
CONFIG_TEGRA=y
CONFIG_TARGET_MX4_T20=y
CONFIG_DEFAULT_DEVICE_TREE="tegra20-colibri"
```
